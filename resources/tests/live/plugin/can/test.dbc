// SPDX-FileCopyrightText: 2021 Forschungs- und Entwicklungszentrum Fachhochschule Kiel GmbH
//
// SPDX-License-Identifier: CC0-1.0

VERSION "1.0"

BS_:

BU_: RECEIVER1 RECEIVER2

BO_ 256 Weather: 2 SENDER
 SG_ Temperature : 0|8@1+ (1,0) [0|120] "℃"  RECEIVER1
 SG_ Humidity : 8|8@1+ (1,0) [0|100] "%" RECEIVER1
